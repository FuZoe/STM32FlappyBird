/* USER CODE BEGIN Header */
/**
  ******************************************************************************
  * @file           : main.c
  * @brief          : Main program body
  ******************************************************************************
  * @attention
  *
  * 基于STM32单片机的飞翔的小鸟小游戏Flappy Bird
  * 适用于为STM32单片机，本代码在STM32F103C8T6单片机上测试通过，在其他STM32单片机只要修改少量代码也可以使用。
  * 游戏效果可以 关注 微信公众号、B站、抖音和快手等平台（账号名称：JL单片机），有录制的视频的效果。
  * 也分享了其他好玩有趣的代码，比如基于STM32的小恐龙游戏，俄罗斯方块游戏等，代码都已经开源，感兴趣的可以看下。

		材料：
		STM32F103C8T6最小系统板
		SSD1306 OLED128*64显示屏
		一个按键


		IO连接说明：

		OLED SCK---PA11
		OLED SDA---PA12
		按键----PA7
  * Copyright (c) 2024 STMicroelectronics.
  * All rights reserved.
  *
  * This software is licensed under terms that can be found in the LICENSE file
  * in the root directory of this software component.
  * If no LICENSE file comes with this software, it is provided AS-IS.
  *
  ******************************************************************************
  */
/* USER CODE END Header */
/* Includes ------------------------------------------------------------------*/
#include "main.h"

/* Private includes ----------------------------------------------------------*/
/* USER CODE BEGIN Includes */
#include <stdlib.h>
#include "OLED.h"
/* USER CODE END Includes */

/* Private typedef -----------------------------------------------------------*/
/* USER CODE BEGIN PTD */

/* USER CODE END PTD */

/* Private define ------------------------------------------------------------*/
/* USER CODE BEGIN PD */

/* USER CODE END PD */

/* Private macro -------------------------------------------------------------*/
/* USER CODE BEGIN PM */

/* USER CODE END PM */

/* Private variables ---------------------------------------------------------*/

/* USER CODE BEGIN PV */

int x1;
int y1;
int x2;
int y2;
int bs;
int bird_y;
long score;

unsigned char cover[] = {
0x0, 0x0, 0xc, 0x0, 0x0, 0x0, 0x0, 0x80, 0x80, 0x80, 0x80, 0x80,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 0x0,
0x0, 0x0, 0x0, 0xc, 0x4, 0x0, 0x0, 0x0, 0x0, 0x0, 0x0, 0x0,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 0x0,
0x0, 0x0, 0x0, 0x0, 0x0, 0xfe, 0xff, 0xff, 0xff, 0xff, 0xf7, 0xf7,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 0x0,
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0xc, 0x38, 0x60, 0x80, 0x60, 0x38, 0xc, 0x0, 0xfc, 0x0, 0x80, 0x0,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 0x0,
};

unsigned char game_over[] = {
0xe0, 0x18, 0x1c, 0xc6, 0x62, 0x32, 0x1a, 0xa, 0xa, 0xa, 0xa, 0xa,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 0x80,
0xff, 0x0, 0x0, 0xff, 0x0, 0x0, 0x0, 0xff, 0x1, 0xf1, 0x11, 0x11,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 0xff,
0xff, 0x0, 0x0, 0xff, 0x0, 0x0, 0x0, 0xff, 0x80, 0xff, 0x0, 0x0,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 0xf,
0xf, 0x18, 0x30, 0x63, 0x44, 0x48, 0x50, 0x50, 0x50, 0x50, 0x50, 0x50,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 0x40,
0x40, 0x5f, 0x58, 0x50, 0x50, 0x50, 0x5f, 0x40, 0x40, 0x5f, 0x58, 0x50,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 0x48,
0x4f, 0x40, 0x7e, 0x3, 0x3, 0x3f, 0x40, 0x40, 0x5f, 0x50, 0x50, 0x50, 0x5f, 0x40, 0x7f, 0x7f, 0x0, 0x0, 0x0, 0x0, 0x0,

};

unsigned char image[] = {
0x0, 0x0, 0x0, 0x0, 0x0, 0x0, 0x0, 0x0, 0xe0, 0xe0, 0xf8, 0x1c,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 0x0,
0x0, 0x0, 0x0, 0x0, 0x0, 0x0, 0x0,
0xfc, 0xfc, 0xff, 0x7, 0x7, 0x7, 0x7, 0x7, 0x7, 0x7, 0x7, 0x7,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 0x0,
0x7, 0x7, 0x1f, 0x38, 0x38, 0xe0, 0xe0, 0xe0, 0xe0, 0xe0, 0xe0, 0xe0,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 0xe7,
0xe7, 0xe7, 0xe7, 0xe7, 0xe7, 0xe7, 0xff, 0x38, 0x38,
0x0, 0x0, 0x0, 0x0, 0x0, 0x7, 0x7, 0x7, 0x38, 0x38, 0x38, 0x38,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 0x0,

};
unsigned char bird[] = {
0x18, 0x64, 0xa6, 0x99, 0x81, 0xa7, 0x71, 0x55, 0x56, 0x7c, 0x10,
};


/* USER CODE END PV */

/* Private function prototypes -----------------------------------------------*/
void SystemClock_Config(void);
static void MX_GPIO_Init(void);
/* USER CODE BEGIN PFP */

/* USER CODE END PFP */

/* Private user code ---------------------------------------------------------*/
/* USER CODE BEGIN 0 */
int get_button_status()
{
	if(HAL_GPIO_ReadPin(button_GPIO_Port, button_Pin)==0) return 1;
	return 0;
}

void draw(){          
	OLED_Clear();
	OLED_ShowNum(80, 0, score, 4, OLED_6X8);
	OLED_DrawRectangle(x1, 0, 10, y1, OLED_FILLED);
	OLED_DrawRectangle(x1-2, y1-6, 14, 6, OLED_FILLED);

	OLED_DrawRectangle(x1, y1+20, 10, 64-y1, OLED_FILLED);
	OLED_DrawRectangle(x1-2, y1+20, 14, 6, OLED_FILLED);

	OLED_DrawRectangle(x2, 0, 10, y2, OLED_FILLED);
	OLED_DrawRectangle(x2-2, y2-6, 14, 6, OLED_FILLED);

	OLED_DrawRectangle(x2, y2+20, 10, 64-y2, OLED_FILLED);
	OLED_DrawRectangle(x2-2, y2+20, 14, 6, OLED_FILLED);

	OLED_ShowImage(20, bird_y, 11, 8, bird);


	OLED_Update();
}
/* USER CODE END 0 */

/**
  * @brief  The application entry point.
  * @retval int
  */
int main(void)
{
  /* USER CODE BEGIN 1 */
	unsigned char is_fail = 0;
	x1 = 128;
	x2 = 192;
	y1 = rand()% 42 + 1;
	y2 = rand()% 42 + 1;

	bs = 32;
	bird_y = 10;
	score = 0;
  /* USER CODE END 1 */

  /* MCU Configuration--------------------------------------------------------*/

  /* Reset of all peripherals, Initializes the Flash interface and the Systick. */
  HAL_Init();

  /* USER CODE BEGIN Init */

  /* USER CODE END Init */

  /* Configure the system clock */
  SystemClock_Config();

  /* USER CODE BEGIN SysInit */

  /* USER CODE END SysInit */

  /* Initialize all configured peripherals */
  MX_GPIO_Init();
  /* USER CODE BEGIN 2 */
  OLED_Init();
  /* USER CODE END 2 */

  /* Infinite loop */
  /* USER CODE BEGIN WHILE */
	OLED_ShowImage(0, 0, 128, 64, cover);
	OLED_Update();
	while(get_button_status() == 0){}
  while (1)
  {
		if (is_fail == 0)
		{

			if(get_button_status() == 1) 
			{
				bs = 32;
			}

			x1 = x1 - 2;
			x2 = x2 - 2;
			bs = bs-5;
			bird_y = bird_y - bs / 10; 

			draw();

			if(bird_y < 0){
				bird_y = 0;
			}
			if(bird_y > 64){
			 is_fail = 1;
			}

			if(x1==-10){
				x1 = 128;
				y1 = rand()% 42 + 1;
			}
			if(x2==-10){
				x2 = 128;
				y2 = rand()% 42 + 1;
			}
			if (x1 >= 20 && x1 <= 20 + 11) {
				if(bird_y < y1 || bird_y+8 > y1+20){
					is_fail = 1;
				}
			}
			if (x2 >= 20 && x2 <= 20 + 11) {
				if(bird_y < y2 || bird_y+8 > y2+20){
					is_fail = 1;
				}
			}

			if(x1==16 || x2==16){
				score++;
			}

			HAL_Delay(30);
		}

		if (is_fail == 1)
		{
			HAL_Delay(500);
			OLED_Clear();
			OLED_ShowImage(0, 0, 128, 32, game_over);
			OLED_ShowImage(8, 32, 45, 32, image);
			OLED_ShowString(72, 32, "Score", OLED_8X16);
			OLED_ShowNum(72, 48, score, 4, OLED_8X16);

			OLED_Update();
			HAL_Delay(2000);
			while(get_button_status() == 0);
			is_fail = 0;

			x1 = 128;
			x2 = 192;

			y1 = rand()% 42 + 1;
			y2 = rand()% 42 + 1;

			bs = 32;
			bird_y = 50;
			score = 0;

		}
    /* USER CODE END WHILE */

    /* USER CODE BEGIN 3 */
  }
  /* USER CODE END 3 */
}

/**
  * @brief System Clock Configuration
  * @retval None
  */
void SystemClock_Config(void)
{
  RCC_OscInitTypeDef RCC_OscInitStruct = {0};
  RCC_ClkInitTypeDef RCC_ClkInitStruct = {0};

  /** Initializes the RCC Oscillators according to the specified parameters
  * in the RCC_OscInitTypeDef structure.
  */
  RCC_OscInitStruct.OscillatorType = RCC_OSCILLATORTYPE_HSE;
  RCC_OscInitStruct.HSEState = RCC_HSE_ON;
  RCC_OscInitStruct.HSEPredivValue = RCC_HSE_PREDIV_DIV1;
  RCC_OscInitStruct.HSIState = RCC_HSI_ON;
  RCC_OscInitStruct.PLL.PLLState = RCC_PLL_ON;
  RCC_OscInitStruct.PLL.PLLSource = RCC_PLLSOURCE_HSE;
  RCC_OscInitStruct.PLL.PLLMUL = RCC_PLL_MUL9;
  if (HAL_RCC_OscConfig(&RCC_OscInitStruct) != HAL_OK)
  {
    Error_Handler();
  }

  /** Initializes the CPU, AHB and APB buses clocks
  */
  RCC_ClkInitStruct.ClockType = RCC_CLOCKTYPE_HCLK|RCC_CLOCKTYPE_SYSCLK
                              |RCC_CLOCKTYPE_PCLK1|RCC_CLOCKTYPE_PCLK2;
  RCC_ClkInitStruct.SYSCLKSource = RCC_SYSCLKSOURCE_PLLCLK;
  RCC_ClkInitStruct.AHBCLKDivider = RCC_SYSCLK_DIV1;
  RCC_ClkInitStruct.APB1CLKDivider = RCC_HCLK_DIV2;
  RCC_ClkInitStruct.APB2CLKDivider = RCC_HCLK_DIV1;

  if (HAL_RCC_ClockConfig(&RCC_ClkInitStruct, FLASH_LATENCY_2) != HAL_OK)
  {
    Error_Handler();
  }
}

/**
  * @brief GPIO Initialization Function
  * @param None
  * @retval None
  */
static void MX_GPIO_Init(void)
{
  GPIO_InitTypeDef GPIO_InitStruct = {0};
/* USER CODE BEGIN MX_GPIO_Init_1 */
/* USER CODE END MX_GPIO_Init_1 */

  /* GPIO Ports Clock Enable */
  __HAL_RCC_GPIOD_CLK_ENABLE();
  __HAL_RCC_GPIOA_CLK_ENABLE();

  /*Configure GPIO pin Output Level */
  HAL_GPIO_WritePin(scl_GPIO_Port, scl_Pin, GPIO_PIN_SET);

  /*Configure GPIO pin Output Level */
  HAL_GPIO_WritePin(sda_GPIO_Port, sda_Pin, GPIO_PIN_RESET);

  /*Configure GPIO pin : button_Pin */
  GPIO_InitStruct.Pin = button_Pin;
  GPIO_InitStruct.Mode = GPIO_MODE_INPUT;
  GPIO_InitStruct.Pull = GPIO_PULLUP;
  HAL_GPIO_Init(button_GPIO_Port, &GPIO_InitStruct);

  /*Configure GPIO pins : scl_Pin sda_Pin */
  GPIO_InitStruct.Pin = scl_Pin|sda_Pin;
  GPIO_InitStruct.Mode = GPIO_MODE_OUTPUT_PP;
  GPIO_InitStruct.Pull = GPIO_PULLUP;
  GPIO_InitStruct.Speed = GPIO_SPEED_FREQ_HIGH;
  HAL_GPIO_Init(GPIOA, &GPIO_InitStruct);

/* USER CODE BEGIN MX_GPIO_Init_2 */
/* USER CODE END MX_GPIO_Init_2 */
}

/* USER CODE BEGIN 4 */

/* USER CODE END 4 */

/**
  * @brief  This function is executed in case of error occurrence.
  * @retval None
  */
void Error_Handler(void)
{
  /* USER CODE BEGIN Error_Handler_Debug */
  /* User can add his own implementation to report the HAL error return state */
  __disable_irq();
  while (1)
  {
  }
  /* USER CODE END Error_Handler_Debug */
}

#ifdef  USE_FULL_ASSERT
/**
  * @brief  Reports the name of the source file and the source line number
  *         where the assert_param error has occurred.
  * @param  file: pointer to the source file name
  * @param  line: assert_param error line source number
  * @retval None
  */
void assert_failed(uint8_t *file, uint32_t line)
{
  /* USER CODE BEGIN 6 */
  /* User can add his own implementation to report the file name and line number,
     ex: printf("Wrong parameters value: file %s on line %d\r\n", file, line) */
  /* USER CODE END 6 */
}
#endif /* USE_FULL_ASSERT */
